## Assignment/slave/build/Kconfig/arch/Kconfig
```kconfig
# Load Zephyr Arch Kconfig descriptions.
osource "/home/boris/zephyr/zephyr/arch/x86/Kconfig"
osource "/home/boris/zephyr/zephyr/arch/xtensa/Kconfig"
osource "/home/boris/zephyr/zephyr/arch/sparc/Kconfig"
osource "/home/boris/zephyr/zephyr/arch/riscv/Kconfig"
osource "/home/boris/zephyr/zephyr/arch/posix/Kconfig"
osource "/home/boris/zephyr/zephyr/arch/nios2/Kconfig"
osource "/home/boris/zephyr/zephyr/arch/mips/Kconfig"
osource "/home/boris/zephyr/zephyr/arch/arm64/Kconfig"
osource "/home/boris/zephyr/zephyr/arch/arm/Kconfig"
osource "/home/boris/zephyr/zephyr/arch/arc/Kconfig"
```

## Assignment/slave/build/Kconfig/boards/Kconfig.defconfig
```kconfig
# Load Zephyr board defconfig descriptions.
osource "/home/boris/zephyr/zephyr/boards/nxp/frdm_mcxn236/Kconfig.defconfig"
```

## Assignment/slave/build/Kconfig/boards/Kconfig.frdm_mcxn236
```kconfig
# Load board Kconfig descriptions.
osource "/home/boris/zephyr/zephyr/boards/nxp/frdm_mcxn236/Kconfig.frdm_mcxn236"
```

## Assignment/slave/build/Kconfig/soc/Kconfig
```kconfig
# Load Zephyr SoC Kconfig descriptions.
osource "/home/boris/zephyr/zephyr/soc/xlnx/zynqmp/Kconfig"
osource "/home/boris/zephyr/zephyr/soc/xlnx/zynq7000/Kconfig"
osource "/home/boris/zephyr/zephyr/soc/xen/Kconfig"
osource "/home/boris/zephyr/zephyr/soc/wch/ch32v/Kconfig"
osource "/home/boris/zephyr/zephyr/soc/ti/simplelink/Kconfig"
osource "/home/boris/zephyr/zephyr/soc/ti/lm3s6965/Kconfig"
osource "/home/boris/zephyr/zephyr/soc/ti/k3/Kconfig"
osource "/home/boris/zephyr/zephyr/soc/telink/tlsr/Kconfig"
osource "/home/boris/zephyr/zephyr/soc/starfive/jh71xx/Kconfig"
osource "/home/boris/zephyr/zephyr/soc/st/stm32/Kconfig"
osource "/home/boris/zephyr/zephyr/soc/snps/qemu_arc/Kconfig"
osource "/home/boris/zephyr/zephyr/soc/snps/nsim/arc_v/Kconfig"
osource "/home/boris/zephyr/zephyr/soc/snps/nsim/arc_classic/Kconfig"
osource "/home/boris/zephyr/zephyr/soc/snps/hsdk4xd/Kconfig"
osource "/home/boris/zephyr/zephyr/soc/snps/hsdk/Kconfig"
osource "/home/boris/zephyr/zephyr/soc/snps/emsk/Kconfig"
osource "/home/boris/zephyr/zephyr/soc/snps/emsdp/Kconfig"
osource "/home/boris/zephyr/zephyr/soc/snps/arc_iot/Kconfig"
osource "/home/boris/zephyr/zephyr/soc/silabs/Kconfig"
osource "/home/boris/zephyr/zephyr/soc/sifive/sifive_freedom/Kconfig"
osource "/home/boris/zephyr/zephyr/soc/sensry/Kconfig"
osource "/home/boris/zephyr/zephyr/soc/rockchip/Kconfig"
osource "/home/boris/zephyr/zephyr/soc/renode/riscv_virtual/Kconfig"
osource "/home/boris/zephyr/zephyr/soc/renode/cortex_r8_virtual/Kconfig"
osource "/home/boris/zephyr/zephyr/soc/renesas/smartbond/Kconfig"
osource "/home/boris/zephyr/zephyr/soc/renesas/rzt2m/Kconfig"
osource "/home/boris/zephyr/zephyr/soc/renesas/rz/Kconfig"
osource "/home/boris/zephyr/zephyr/soc/renesas/rcar/Kconfig"
osource "/home/boris/zephyr/zephyr/soc/renesas/ra/Kconfig"
osource "/home/boris/zephyr/zephyr/soc/realtek/ec/Kconfig"
osource "/home/boris/zephyr/zephyr/soc/raspberrypi/rpi_pico/Kconfig"
osource "/home/boris/zephyr/zephyr/soc/quicklogic/eos_s3/Kconfig"
osource "/home/boris/zephyr/zephyr/soc/qemu/virt_riscv/Kconfig"
osource "/home/boris/zephyr/zephyr/soc/qemu/malta/Kconfig"
osource "/home/boris/zephyr/zephyr/soc/openisa/rv32m1/Kconfig"
osource "/home/boris/zephyr/zephyr/soc/nxp/s32/Kconfig"
osource "/home/boris/zephyr/zephyr/soc/nxp/rw/Kconfig"
osource "/home/boris/zephyr/zephyr/soc/nxp/mcx/Kconfig"
osource "/home/boris/zephyr/zephyr/soc/nxp/lpc/Kconfig"
osource "/home/boris/zephyr/zephyr/soc/nxp/layerscape/Kconfig"
osource "/home/boris/zephyr/zephyr/soc/nxp/kinetis/Kconfig"
osource "/home/boris/zephyr/zephyr/soc/nxp/imxrt/Kconfig"
osource "/home/boris/zephyr/zephyr/soc/nxp/imx/Kconfig"
osource "/home/boris/zephyr/zephyr/soc/nuvoton/numicro/Kconfig"
osource "/home/boris/zephyr/zephyr/soc/nuvoton/numaker/Kconfig"
osource "/home/boris/zephyr/zephyr/soc/nuvoton/npcx/Kconfig"
osource "/home/boris/zephyr/zephyr/soc/nuvoton/npcm/Kconfig"
osource "/home/boris/zephyr/zephyr/soc/nordic/Kconfig"
osource "/home/boris/zephyr/zephyr/soc/neorv32/Kconfig"
osource "/home/boris/zephyr/zephyr/soc/native/inf_clock/Kconfig"
osource "/home/boris/zephyr/zephyr/soc/microchip/miv/Kconfig"
osource "/home/boris/zephyr/zephyr/soc/microchip/mec/Kconfig"
osource "/home/boris/zephyr/zephyr/soc/mediatek/mt8xxx/Kconfig"
osource "/home/boris/zephyr/zephyr/soc/lowrisc/opentitan/Kconfig"
osource "/home/boris/zephyr/zephyr/soc/litex/litex_vexriscv/Kconfig"
osource "/home/boris/zephyr/zephyr/soc/ite/ec/Kconfig"
osource "/home/boris/zephyr/zephyr/soc/intel/raptor_lake/Kconfig"
osource "/home/boris/zephyr/zephyr/soc/intel/lakemont/Kconfig"
osource "/home/boris/zephyr/zephyr/soc/intel/intel_socfpga_std/Kconfig"
osource "/home/boris/zephyr/zephyr/soc/intel/intel_socfpga/Kconfig"
osource "/home/boris/zephyr/zephyr/soc/intel/intel_niosv/Kconfig"
osource "/home/boris/zephyr/zephyr/soc/intel/intel_ish/Kconfig"
osource "/home/boris/zephyr/zephyr/soc/intel/intel_adsp/Kconfig"
osource "/home/boris/zephyr/zephyr/soc/intel/elkhart_lake/Kconfig"
osource "/home/boris/zephyr/zephyr/soc/intel/atom/Kconfig"
osource "/home/boris/zephyr/zephyr/soc/intel/apollo_lake/Kconfig"
osource "/home/boris/zephyr/zephyr/soc/intel/alder_lake/Kconfig"
osource "/home/boris/zephyr/zephyr/soc/infineon/cat3/Kconfig"
osource "/home/boris/zephyr/zephyr/soc/infineon/cat1b/Kconfig"
osource "/home/boris/zephyr/zephyr/soc/infineon/cat1a/Kconfig"
osource "/home/boris/zephyr/zephyr/soc/gd/gd32/Kconfig"
osource "/home/boris/zephyr/zephyr/soc/gaisler/leon3/Kconfig"
osource "/home/boris/zephyr/zephyr/soc/gaisler/gr716a/Kconfig"
osource "/home/boris/zephyr/zephyr/soc/espressif/Kconfig"
osource "/home/boris/zephyr/zephyr/soc/ene/kb1200/Kconfig"
osource "/home/boris/zephyr/zephyr/soc/efinix/sapphire/Kconfig"
osource "/home/boris/zephyr/zephyr/soc/cdns/xtensa_sample_controller/Kconfig"
osource "/home/boris/zephyr/zephyr/soc/cdns/sample_controller32/Kconfig"
osource "/home/boris/zephyr/zephyr/soc/cdns/dc233c/Kconfig"
osource "/home/boris/zephyr/zephyr/soc/brcm/bcmvk/Kconfig"
osource "/home/boris/zephyr/zephyr/soc/brcm/bcm2712/Kconfig"
osource "/home/boris/zephyr/zephyr/soc/brcm/bcm2711/Kconfig"
osource "/home/boris/zephyr/zephyr/soc/atmel/sam0/Kconfig"
osource "/home/boris/zephyr/zephyr/soc/atmel/sam/Kconfig"
osource "/home/boris/zephyr/zephyr/soc/aspeed/Kconfig"
osource "/home/boris/zephyr/zephyr/soc/arm/Kconfig"
osource "/home/boris/zephyr/zephyr/soc/arm/beetle/Kconfig"
osource "/home/boris/zephyr/zephyr/soc/antmicro/myra/Kconfig"
osource "/home/boris/zephyr/zephyr/soc/andestech/Kconfig"
osource "/home/boris/zephyr/zephyr/soc/amd/acp_6_0/Kconfig"
osource "/home/boris/zephyr/zephyr/soc/ambiq/Kconfig"
osource "/home/boris/zephyr/zephyr/soc/altr/zephyr_nios2f/Kconfig"
osource "/home/boris/zephyr/zephyr/soc/altr/qemu_nios2/Kconfig"
osource "/home/boris/zephyr/zephyr/soc/adi/max32/Kconfig"
```
